## Documentation/devicetree/bindings/reserved-memory/lendable-dma-pool.yaml
```yaml
# SPDX-License-Identifier: (GPL-2.0-only OR BSD-2-Clause)
%YAML 1.2
---
$id: http://devicetree.org/schemas/reserved-memory/lendable-dma-pool.yaml#
$schema: http://devicetree.org/meta-schemas/core.yaml#

title: /reserved-memory Lendable DMA Pool

maintainers:
  - Vincent Donnefort <vdonnefort@google.com>

description: |
  This indicates a region of memory meant to be used as a pool of DMA buffers
  that can be dynamically unmapped from the kernel direct map (e.g. before
  lending to a secure world such as via Arm FF-A).

  On architectures where the direct map cannot be arbitrarily modified at
  runtime (such as arm64 without BBML3 or without rodata=full), the operating
  system ensures this pool is mapped using last-level (PTE) page table entries.

  The reusable property must be set, and no-map must not be set.

allOf:
  - $ref: reserved-memory.yaml

properties:
  compatible:
    const: lendable-dma-pool

  linux,cma-default:
    type: boolean
    description: >
      If this property is present, then Linux will use the region for
      the default pool of the contiguous memory allocator.

  no-map: false

required:
  - compatible
  - reusable

unevaluatedProperties: false

examples:
  - |
    reserved-memory {
        #address-cells = <1>;
        #size-cells = <1>;
        ranges;

        linux,cma {
            compatible = "lendable-dma-pool";
            reusable;
            size = <0x4000000>;
            alignment = <0x200000>;
            linux,cma-default;
        };
    };
```

## drivers/dma-buf/heaps/Kconfig
```kconfig
config DMABUF_HEAPS_SYSTEM
	tristate "DMA-BUF System Heap"
	depends on DMABUF_HEAPS
	help
	  Choose this option to enable the system dmabuf heap. The system heap
	  is backed by pages from the buddy allocator. If in doubt, say Y.

config DMABUF_HEAPS_SYSTEM_CC_SHARED
	bool "DMA-BUF System Heap for decrypted CoCo VMs"
	depends on DMABUF_HEAPS && ARCH_HAS_MEM_ENCRYPT && DMABUF_HEAPS_SYSTEM=y
	help
	  Choose this option to enable the system_cc_shared dmabuf heap. This
	  allows allocating shared (decrypted) memory for confidential computing
	  (CoCo) VMs.

config DMABUF_HEAPS_CMA
	tristate "DMA-BUF CMA Heap"
	depends on DMABUF_HEAPS && DMA_CMA
	help
	  Choose this option to enable dma-buf CMA heap. This heap is backed
	  by the Contiguous Memory Allocator (CMA). If your system has these
	  regions, you should say Y here.

config DMABUF_HEAPS_TEGRA_VPR
	bool "NVIDIA Tegra Video-Protected-Region DMA-BUF Heap"
	depends on DMABUF_HEAPS && DMA_CMA
	help
	  Choose this option to enable Video-Protected-Region (VPR) support on
	  a range of NVIDIA Tegra devices. Access to VPR memory is limited to
	  a subset of hardware engines and specifically disallowed from the
	  CPU. The region can be fixed, in which case no linear mapping exists
	  for the memory, or it can be resizable on systems that want to reuse
	  the memory for other uses when content-protected video is not played
	  back.
```

## drivers/migrate_offload/Kconfig
```kconfig
config DCBM_DMA
	tristate "DMA Core Batch Migrator"
	depends on MIGRATION && DMA_ENGINE
	select MIGRATION_COPY_OFFLOAD
	help
	  DMA-based batch copy engine for page migration. Uses
	  DMAEngine memcpy channels to offload folio data copies
	  during migration. Primarily intended for testing the copy
	  offload infrastructure.
```

## security/kap/Kconfig
```kconfig
config SECURITY_KAP
	bool "Kernel Assurance Plane security module"
	depends on SECURITY
	select SECURITYFS
	select SECURITY_PATH
	help
	  The Kernel Assurance Plane binds tasks to Intent Lineage Groups and
	  checks their operations at LSM hooks against the authority compiled
	  for the objective each group serves. Privileged userspace validates
	  policy and installs it through /sys/kernel/security/kap.

	  See Documentation/security/kap.rst for details.

	  If you are unsure how to answer this question, answer N.
```
